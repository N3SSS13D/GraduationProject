## External/xiaozhi-esp32/sdkconfig.defaults.esp32
```kconfig
CONFIG_ESPTOOLPY_FLASHSIZE_4MB=y
CONFIG_PARTITION_TABLE_CUSTOM=y
CONFIG_PARTITION_TABLE_CUSTOM_FILENAME="partitions/v2/4m.csv"
CONFIG_SR_WN_WN9_NIHAOXIAOZHI_TTS=y
CONFIG_ESP_TASK_WDT_TIMEOUT_S=20
CONFIG_GP_MATRIX_TRANSPORT_BT_SPP=y
CONFIG_BT_ENABLED=y
CONFIG_BT_BLUEDROID_ENABLED=y
CONFIG_GP_MATRIX_BT_LOCAL_NAME="XiaoZhi-Matrix"
CONFIG_GP_MATRIX_BT_REMOTE_NAME="HC-05"
CONFIG_GP_MATRIX_BT_REMOTE_ADDR=""
CONFIG_GP_MATRIX_BT_PIN_CODE="1234"
CONFIG_GP_MATRIX_BT_CONNECT_TIMEOUT_MS=12000
```
